/dts-v1/;

/ {
	model = "Qualcomm Technologies, Inc. Cliffs QRD";
	compatible = "qcom,cliffs-qrd\0qcom,cliffs\0qcom,qrd";
	qcom,msm-id = <0x278 0x10000 0x266 0x10000>;
	qcom,board-id = <0x0b 0x00>;
};
