/dts-v1/;

/ {
	model = "Qualcomm Technologies, Inc. Cliffs ATP";
	compatible = "qcom,cliffs-atp\0qcom,cliffs\0qcom,atp";
	qcom,msm-id = <0x278 0x10000 0x266 0x10000>;
	qcom,board-id = <0x21 0x00>;
};
