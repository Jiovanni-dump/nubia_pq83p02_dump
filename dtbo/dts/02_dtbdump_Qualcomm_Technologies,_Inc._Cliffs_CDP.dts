/dts-v1/;

/ {
	model = "Qualcomm Technologies, Inc. Cliffs CDP";
	compatible = "qcom,cliffs-cdp\0qcom,cliffs\0qcom,cdp";
	qcom,msm-id = <0x278 0x10000 0x266 0x10000>;
	qcom,board-id = <0x01 0x00>;
};
